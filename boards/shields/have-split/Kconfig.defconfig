## boards/shields/have-split/Kconfig.defconfig
```kconfig
if SHIELD_HAVE_SPLIT

# Name must be less than 16 characters long!
config ZMK_KEYBOARD_NAME
    default "have-split"

endif
```

## boards/shields/lets-split-rev2/Kconfig.defconfig
```kconfig
if SHIELD_LETS_SPLIT_REV2_LEFT

# Name must be less than 16 characters long!
config ZMK_KEYBOARD_NAME
    default "lets-split-rev2"

config ZMK_SPLIT_ROLE_CENTRAL
    default y

endif

if SHIELD_LETS_SPLIT_REV2_LEFT || SHIELD_LETS_SPLIT_REV2_RIGHT

config ZMK_SPLIT
    default y

endif
```

## boards/shields/lets-split-rev2/Kconfig.shield
```kconfig
config SHIELD_LETS_SPLIT_REV2_LEFT
    def_bool $(shields_list_contains,lets_split_rev2_left)

config SHIELD_LETS_SPLIT_REV2_RIGHT
    def_bool $(shields_list_contains,lets_split_rev2_right)
```
